## meta-openbmc-machines/meta-x86/meta-supermicro/conf/layer.conf
```bitbake
# We have a conf and classes directory, add to BBPATH
BBPATH .= ":${LAYERDIR}"

BBFILE_COLLECTIONS += "supermicro"
BBFILE_PATTERN_supermicro = ""
```

## meta-openbmc-machines/meta-x86/meta-supermicro/meta-x11/conf/machine/x11.conf
```bitbake
KMACHINE = "aspeed"
KERNEL_DEVICETREE = "${KMACHINE}-bmc-supermicro-${MACHINE}.dtb"
PREFERRED_PROVIDER_virtual/kernel = "linux-obmc"

require conf/machine/include/ast2400.inc
require conf/machine/include/obmc-bsp-common.inc

UBOOT_MACHINE_x11 = "ast_g4_ncsi_config"
UBOOT_ENTRYPOINT = "0x40008000"
UBOOT_LOADADDRESS = "0x40008000"

FLASH_SIZE = "32768"

PHOSPHOR_MRW_URI = "git://github.com/open-power/palmetto-xml"
PHOSPHOR_MRW_REV = "82818682f2c2009c30d700df6d5f8897a3096e4f"

PREFERRED_PROVIDER_virtual/obmc-inventory-data = "obmc-inventory"
PREFERRED_PROVIDER_virtual/phosphor-led-manager-config-native = "x11-led-manager-config-native"
```

## meta-x86/conf/layer.conf
```bitbake
# We have a conf and classes directory, add to BBPATH
BBPATH .= ":${LAYERDIR}"

# We have recipes-* directories, add to BBFILES
BBFILES += "${LAYERDIR}/common/recipes-*/*/*.bb \
	${LAYERDIR}/common/recipes-*/*/*.bbappend"

BBFILE_COLLECTIONS += "obmc_machines_x86"
BBFILE_PATTERN_obmc_machines_x86 = ""
LAYERSERIES_COMPAT_obmc_machines_x86 = "thud"
```

## meta-x86/conf/machine/include/x86.inc
```bitbake
OBMC_MACHINE_FEATURES += "\
        obmc-phosphor-fan-mgmt \
        obmc-phosphor-chassis-mgmt \
        obmc-phosphor-flash-mgmt \
        obmc-host-ipmi \
        obmc-chassis-state-mgmt \
        obmc-bmc-state-mgmt \
        "

PREFERRED_PROVIDER_virtual/obmc-chassis-mgmt = "packagegroup-x86-apps"
PREFERRED_PROVIDER_virtual/obmc-fan-mgmt = "packagegroup-x86-apps"
PREFERRED_PROVIDER_virtual/obmc-flash-mgmt = "packagegroup-x86-apps"
PREFERRED_PROVIDER_virtual/obmc-system-mgmt = "packagegroup-x86-apps"
```
